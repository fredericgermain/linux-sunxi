## Documentation/devicetree/bindings/mfd/axp20x.txt
```
* axp20x device tree bindings

The axp20x family current members :-
axp202 (X-Powers)
axp209 (X-Powers)

Required properties:
- compatible 			: Should be "x-powers,axp202" or "x-powers,axp209"
- interrupt-controller 		: axp20x has its own internal IRQs
- #interrupt-cells 		: Should be set to 1
- interrupt-parent 		: The parent interrupt controller
- interrupts 			: Interrupt specifiers for interrupt sources
- reg 				: The I2C slave address for the AXP chip
- axp,system-power-controller	: Telling whether or not this pmic is
				  controlling the system power

Sub-nodes:
* regulators : Contain the regulator nodes. The regulators are bound using
	       their name as listed here: dcdc2, dcdc3, ldo1, ldo2, ldo3,
	       ldo4, ldo5.
	       The bindings details of individual regulator device can be found in:
	       Documentation/devicetree/bindings/regulator/regulator.txt with the
	       exception of:

	- dcdc-freq		: defines the work frequency of DC-DC in KHz
				  (range: 750-1875)
	- dcdc-workmode		: 1 for PWM mode, 0 for AUTO mode

* axp20x-pek : Power Enable Key
	- compatible		: should be "x-powers,axp20x-pek"

Example:

axp: axp20x@34 {
	reg = <0x34>;
	interrupt-parent = <&nmi_intc>;
	interrupts = <0 8>;

	axp,system-power-controller;

	compatible = "x-powers,axp209";
	interrupt-controller;
	#interrupt-cells = <1>;

	axp20x-pek {
		compatible = "x-powers,axp20x-pek";
	};

	regulators {
		dcdc-freq = "8";

		axp_dcdc2: dcdc2 {
			regulator-min-microvolt = <700000>;
			regulator-max-microvolt = <2275000>;
			dcdc-workmode = <0>;
			regulator-always-on;
		};

		axp_dcdc3: dcdc3 {
			regulator-min-microvolt = <700000>;
			regulator-max-microvolt = <3500000>;
			dcdc-workmode = <0>;
			regulator-always-on;
		};

		axp_ldo1: ldo1 {
			regulator-min-microvolt = <1300000>;
			regulator-max-microvolt = <1300000>;
		};

		axp_ldo2: ldo2 {
			regulator-min-microvolt = <1800000>;
			regulator-max-microvolt = <3300000>;
			regulator-always-on;
		};

		axp_ldo3: ldo3 {
			regulator-min-microvolt = <700000>;
			regulator-max-microvolt = <3500000>;
		};

		axp_ldo4: ldo4 {
			regulator-min-microvolt = <1250000>;
			regulator-max-microvolt = <3300000>;
		};

		axp_ldo5: ldo5 {
			regulator-min-microvolt = <1800000>;
			regulator-max-microvolt = <3300000>;
		};
	};
};
```
